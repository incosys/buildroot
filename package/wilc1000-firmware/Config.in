## package/wilc1000-firmware/Config.in
```kconfig
config BR2_PACKAGE_WILC1000_FIRMWARE
	bool "wilc1000-firmware"
	help
	  Firmware for Atmel Wilc1000 wireless device

	  https://github.com/inco/wireless-firmware.git
```
